## sources/linux-2.6.27/linux-2.6.27/arch/arm/mach-parrot6/Kconfig
```kconfig
menu "Parrot6 machines"
	depends on ARCH_PARROT6

config ARCH_VARIANT_PARROT6
	bool
	default n

config ARCH_VARIANT_PARROT6I
	bool
	default n

config MACH_PARROT_P6DEV
	bool "Parrot6 devboard"
	select ARCH_VARIANT_PARROT6
	default y
	help
		Say Y here if you are using a P6dev board.

config MACH_PARROT_P6IDEV
	bool "Parrot6i devboard"
	select ARCH_VARIANT_PARROT6I
	default n
	help
		Say Y here if you are using a P6idev board.

config MACH_PARROT_PARELIA
	bool "Parrot parelia"
	select ARCH_VARIANT_PARROT6
	default n
	help
		Say Y here if you are using a parelia board.

config MACH_PARROT_OKIA
	bool "Parrot okia"
	select MACH_PARROT_PARELIA
	default n
	help
		Say Y here if you are using a okia board.

config MACH_PARROT_RNB4
	bool "Parrot RnB4"
	select ARCH_VARIANT_PARROT6
	default n
	help
		Say Y here if you are using a RnB4 board.

config MACH_PARROT_FC6XXX
	bool "Parrot FC6xxx"
	select ARCH_VARIANT_PARROT6
	default n
	help
		Say Y here if you are using a FC6xxx board.

config MACH_PARROT_FC6050
	bool "Parrot FC6050"
	select ARCH_VARIANT_PARROT6I
	default n
	help
		Say Y here if you are using a FC6050 board.

config MACH_PARROT_MYKONOS
	bool "Parrot mykonos"
	select ARCH_VARIANT_PARROT6
	default n
	help
		Say Y here if you are using a Mykonos board.

endmenu
```

## sources/linux-2.6.27/linux-2.6.27/arch/arm/mach-versatile/Kconfig
```kconfig
menu "Versatile platform type"
	depends on ARCH_VERSATILE

config ARCH_VERSATILE_PB
	bool "Support Versatile/PB platform"
	default y
	help
	  Include support for the ARM(R) Versatile/PB platform.

config MACH_VERSATILE_AB
	bool "Support Versatile/AB platform"
	help
	  Include support for the ARM(R) Versatile/AP platform.

config VERSATILE_PARROT6
	bool "Support Parrot6 on FPGA"
	default n
	select VERSATILE_PARROT_TIC
	help
	  Include support for the Parrot6 on FPGA.

config VERSATILE_PARROT_TIC
	bool
	default n

config FB_P6
	tristate "Parrot6 LCD framebuffer support"
	depends on FB && VERSATILE_PARROT6
	select FB_CFB_FILLRECT
	select FB_CFB_COPYAREA
	select FB_CFB_IMAGEBLIT
	---help---
	  This will enable support for LCD controller in Parrot6.
	  You still need to build the Parrot6 LCD driver as an external
	  module.

config P6_NANDMC
    bool "Barco-Silex BA315 NAND flash controller support for Parrot6"
    default n
    help
	    This will enable support for Parrot6 NAND flash memory controller.
	    You still need to build the BA315 driver as an external module.

endmenu
```

## sources/linux-2.6.27/linux-2.6.27/drivers/parrot/sound/p6_aai/Kconfig
```kconfig
config AAI_PARROT6
	bool "Parrot6 AAI"
	depends on SND
	depends on ARCH_PARROT6
	select SND_PCM
	select SND_HWDEP
    help
        Parrot6 AAI Driver.
        The driver uses ARM fast interrupts.
        For this reason it has to be statically linked, and not embedded as a kernel object.

config AAI_PARROT6_DEBUG
	bool  "compile with -O0 option"
	default n
	depends on AAI_PARROT6

config AAI_DBG_LEVEL
	int  "activate debug messages"
	default 0
	depends on AAI_PARROT6
   help
      level 0 : no messages
      level 1 : print importants, warning and error messages
      level 2 : add info messages
      level 3 : full verbose mode 
```

## sources/linux-2.6.27/linux-2.6.27/drivers/parrot/usb/dwc_otg/Kconfig
```kconfig
config USB_PARROT6
	tristate "PARROT6 USB driver (Synopsys)"
    depends on USB && (ARCH_PARROT6 || VERSATILE_PARROT6)

config USB_PARROT6_DEBUG
	bool "PARROT6 USB debug"
	depends on USB_PARROT6
    default n
	help
        Select this option to allow debug.
```
